// Settings tuned for 3840 x 2160 display resolution
#define ZMK_POINTING_DEFAULT_MOVE_VAL 1800 // 600
#define ZMK_POINTING_DEFAULT_SCRL_VAL 20  // 10

#include <dt-bindings/zmk/pointing.h>
#include <input/processors.dtsi>
#include <zephyr/dt-bindings/input/input-event-codes.h>

// Based on @caksoylar's config, defaults in comments

&mmv {
  acceleration-exponent = <2>;          // 1
  time-to-max-speed-ms = <1000>;        // 300
  delay-ms = <0>;                       // 0
};

&msc {
  acceleration-exponent = <0>;          // 0
  time-to-max-speed-ms = <300>;         // 300
  delay-ms = <100>;                       // 0
};

/ {
  zip_scroll_scaler: zip_scroll_scaler {
    compatible = "zmk,input-processor-scaler";
    #input-processor-cells = <2>;
    type = <INPUT_EV_REL>;
    codes = <INPUT_REL_WHEEL INPUT_REL_HWHEEL>;
    track-remainders;
  };
};

#define MMU &mmv MOVE_UP
#define MMD &mmv MOVE_DOWN
#define MML &mmv MOVE_LEFT
#define MMR &mmv MOVE_RIGHT
#define MSU &msc SCRL_UP
#define MSD &msc SCRL_DOWN
#define MSL &msc SCRL_LEFT
#define MSR &msc SCRL_RIGHT
